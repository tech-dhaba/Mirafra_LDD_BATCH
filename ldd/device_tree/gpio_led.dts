/dts-v1/;
/plugin/;

/ {
    fragment@0 {
        target = <&gpio>;
        __overlay__ {
            gpio_out {
                compatible = "gpio-leds";
                #address-cells = <1>;
                #size-cells = <0>;

                led@17 {
                    label = "led";
                    reg = <17>;  /* GPIO pin 17 */
                    gpios = <&gpio 17 0>;  /* GPIO controller and pin */
                };
            };
        };
    };
};

