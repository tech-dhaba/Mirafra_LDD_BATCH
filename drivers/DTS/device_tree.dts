/dts-v1/; //kernerl version
/plugin/; //hard plugin

/{
    compatible = "brcm,bcm2835"; //device name: Raspberry Pi 4 model B

    fragment@0 {
        target = <&gpio>;       //here target is gpio
        _overlay_ {                  
            gpio_led: gpio_led {
                gpios = <&gpio 27 0>; // GPIO 17 is used for the LED
            };
        };
    };
};
